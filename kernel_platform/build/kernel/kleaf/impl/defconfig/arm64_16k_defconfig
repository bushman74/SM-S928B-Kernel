## kernel_platform/build/kernel/kleaf/impl/defconfig/arm64_16k_defconfig
```kconfig
# CONFIG_ARM64_4K_PAGES is not set
CONFIG_ARM64_16K_PAGES=y
CONFIG_PAGE_BLOCK_ORDER=8 # nocheck: To be compatible with 2025-06 and earlier releases
# CONFIG_ARM64_64K_PAGES is not set
```
